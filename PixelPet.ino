

// =================== ICONOS y ANIMACIONES ===================
const unsigned char PROGMEM huevo1[] = {
    0x00, 0x00, 0x00, 0x00,
    0x00, 0x00, 0x00, 0x00,
  0x00, 0x0F, 0xF0, 0x00,
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  0x00, 0x00, 0x00, 0x00,
};

const unsigned char PROGMEM huevo2[] = {
 0x00, 0x00, 0x00, 0x00,
  0x00, 0x00, 0x00, 0x00,
  0x00, 0x00, 0x00, 0x00,
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  0x00, 0x00, 0x00, 0x00,};
const unsigned char PROGMEM huevo3[] = {
 0x00, 0x00, 0x00, 0x00,
  0x00, 0x00, 0x00, 0x00,
  0x00, 0x0F, 0xF0, 0x00,
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  0x00, 0x00, 0x00, 0x00,};
const unsigned char PROGMEM huevo4[] = {
  0x00, 0x00, 0x00, 0x00,
  0x00, 0x0F, 0xF0, 0x00,
  0x00, 0x1F, 0xF8, 0x00,
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  0x00, 0x00, 0x00, 0x00,};
const unsigned char PROGMEM bb1[] = {
  0x00, 0x00, 0x00, 0x00,
  0x00, 0x00, 0x00, 0x00,
  0x00, 0x00, 0x00, 0x00,
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  0x00, 0x00, 0x00, 0x00,};
const unsigned char PROGMEM bb2[] = {
 0x00, 0x00, 0x00, 0x00,
  0x00, 0x00, 0x00, 0x00,
  0x00, 0x00, 0x00, 0x00,
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  0x00, 0x00, 0x00, 0x00,};
const unsigned char PROGMEM bb3[] = {
0x00, 0x00, 0x00, 0x00,
  0x00, 0x00, 0x00, 0x00,
  0x00, 0x00, 0x00, 0x00,
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  0x00, 0x00, 0x00, 0x00,};
const unsigned char PROGMEM bb4[] = {
0x00, 0x00, 0x00, 0x00,
  0x00, 0x00, 0x00, 0x00,
  0x00, 0x00, 0x00, 0x00,
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  0x00, 0x00, 0x00, 0x00,};
const unsigned char PROGMEM ninoBajo[] = {
0x00, 0x00, 0x00, 0x00,
  0x00, 0x00, 0x00, 0x00,
  0x00, 0x00, 0x00, 0x00,
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  0x00, 0x00, 0x00, 0x00,};
const unsigned char PROGMEM adulto1[] = {
0x00, 0x00, 0x00, 0x00,
  0x00, 0x00, 0x00, 0x00,
  0x00, 0x00, 0x7E, 0xF8,
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  0x00, 0x00, 0x00, 0x00,};
const unsigned char PROGMEM adulto2[] = {
0x00, 0x00, 0x00, 0x00,
  0x00, 0x00, 0x00, 0x00,
  0x00, 0x00, 0x7E, 0xF8,
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  0x00, 0x00, 0x00, 0x00,};
const unsigned char PROGMEM adulto3[] = {
0x00, 0x00, 0x00, 0x00,
  0x00, 0x00, 0x00, 0x00,
  0x00, 0x00, 0x7E, 0xF8,
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  0x00, 0x00, 0x00, 0x00,};
const unsigned char PROGMEM adulto4[] = {
0x00, 0x00, 0x00, 0x00,
  0x00, 0x00, 0x00, 0x00,
  0x00, 0x00, 0x7E, 0xF8,
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  0x00, 0x00, 0x00, 0x00,};
const unsigned char PROGMEM adultoBajo[] = {
0x00, 0x00, 0x00, 0x00,
  0x00, 0x00, 0x00, 0x00,
  0x00, 0x00, 0x00, 0x00,
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  0x00, 0x00, 0x00, 0x00,};
const unsigned char PROGMEM tumba[] = {
0x00, 0x01, 0x80, 0x00,
  0x00, 0x01, 0x80, 0x00,
  0x00, 0x07, 0xE0, 0x00,
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  0x00, 0x00, 0x00, 0x00,
};
// extras 
const unsigned char PROGMEM iconoCorazon[] = {0x77, 0x00,  0xDF, 0x80,  0xBF, 0x80,  0xFF, 0x80,  0xFF, 0x80,  0x7F, 0x00,  0x3E, 0x00,  0x1C, 0x00,  0x08, 0x00,  0x00, 0x00,};
const unsigned char PROGMEM iconoPajaro[] = { 0x00, 0x00,  0x00, 0x00,  0xE0, 0x00,  0xB3, 0xF8,  0xD7, 0xFC,  0x6F, 0xF6,  0x5F, 0x7E,  0x2E, 0xF8,  0x5E, 0xDE,  0x6E, 0x3E,  0xD7, 0xFC,  0xB3, 0xF8,  0xE0, 0x00,  0x00, 0x00,  0x00, 0x00,};


// ==== Iconos menu cocina ====
// 15x15 ejemplo simple
const unsigned char PROGMEM iconoPan[] = { 0x00, 0x00, 0x00, 0x00, 0x00,0x0F, 0xFF, 0xFF, 0xF8, 0x30,  0x0F, 0xFF, 0xFF,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 0x30,
  0x0F, 0xFF, 0xFF, 0xF8, 0x30,  0x0F, 0x9F, 0xFF, 0xF8, 0x30,  0x0F, 0x9F,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 0x30,
  0x0F, 0xFF, 0xFF, 0xF8, 0x30,  0x0F, 0xFF, 0xFF, 0xF8, 0x30,  0x0C, 0x7F,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 0x00,};
const unsigned char PROGMEM iconoGalleta[] = {0x00, 0x00, 0x00, 0x00, 0x00,  0x00, 0x07, 0xFF, 0xE0, 0x00,  0x00, 0x07, 0xFF,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 0xC0,
  0x03, 0x87, 0xFF, 0x07, 0xC0,  0x0F, 0x87, 0xFF, 0x07, 0xF0,  0x0F, 0x87,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 0xCE,
  0x73, 0x87, 0x1F, 0xFF, 0xCE,  0x73, 0x87, 0x1F, 0xFF, 0xCE,  0x73, 0x87,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 0x00, };
const unsigned char PROGMEM iconoCarne[] = {0x00, 0x00, 0x00, 0x00, 0x00,  0x03, 0xFC, 0x00, 0x00, 0x00,  0x03, 0xFC, 0x00,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 0xC0,
    0x70, 0x00, 0xFF, 0xFF, 0xC0,  0x70, 0x00, 0x00, 0x06, 0x30,  0x70, 0x00,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 0x0E,
    0x0C, 0x00, 0x00, 0x01, 0xCE,  0x0C, 0x00, 0x00, 0x01, 0xCE,  0x73, 0x80,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 0x00,};
const unsigned char PROGMEM iconoSopa[] = {0x00, 0x00, 0x00, 0x00, 0x00,  0x0F, 0x80, 0x00, 0x00, 0x00,  0x0F, 0x80, 0x00,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 0x00,
  0x00, 0x7C, 0x00, 0x00, 0x00,  0x03, 0x9F, 0x1F, 0xFE, 0x00,  0x03, 0x9F,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 0xCE,
  0x73, 0x9F, 0xFF, 0xFF, 0xCE,  0x73, 0x9F, 0xFF, 0xFF, 0xCE,  0x0C, 0x7F,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 0x00,};
const unsigned char PROGMEM iconoHamburguesa[] = { 0x00, 0x00, 0x00, 0x00, 0x00,  0x00, 0x7F, 0xFF, 0xFE, 0x00,  0x00, 0x7F, 0xFF,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 0xF0,
  0x0C, 0x7F, 0xFF, 0xFF, 0xF0,  0x7F, 0xE3, 0xF8, 0xFE, 0x3E,  0x7F, 0xE3,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 0xFE,
  0x00, 0x00, 0x1F, 0x00, 0x00,  0x00, 0x00, 0x1F, 0x00, 0x00,  0x0F, 0xFF,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 0x00,};


const unsigned char PROGMEM iconoVitamina[] = {0x00, 0x00, 0x00, 0x00, 0x00,  0x03, 0xFF, 0x00, 0x00, 0x00,  0x03, 0xFF, 0x00,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 0x00,
    0x70, 0x7C, 0x18, 0x00, 0x00,  0x70, 0x00, 0x07, 0x00, 0x00,  0x70, 0x00,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 0xF0,
    0x00, 0x1C, 0xFF, 0xFF, 0xFE,  0x00, 0x1C, 0xFF, 0xFF, 0xFE,  0x00, 0x03,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 0x00,};
const unsigned char PROGMEM iconoEnergetizante[] = {0x00, 0x00, 0x00, 0x00, 0x00,  0x01, 0xFF, 0xFF, 0xFF, 0x00,  0x01, 0xFF, 0xFF,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 0x18,
  0x38, 0x0E, 0x0F, 0xE0, 0x18,  0x3E, 0x00, 0x00, 0x00, 0xF8,  0x3E, 0x00,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 0xF8,
    0x39, 0xC1, 0xFF, 0x9F, 0x18,  0x39, 0xC1, 0xFF, 0x9F, 0x18,  0x3F, 0xFE,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 0x00,};

// ==== Iconos inferiores ====
// 16x16 ejemplo simple
const unsigned char PROGMEM iconoFood[] = {0x00, 0x00,0x30, 0x00,0x30, 0x00,0xCF, 0xC0,0xDF, 0xF0,0x7F, 0xF8, 0x7F, 0xFC, 0x5F, 0x82,0x6B, 0x02, 0x56, 0x04,0x2A, 0x18,0x16, 0x1E, 0x0E, 0x2E,0x03, 0xCC, 0x00, 0x00,0x00, 0x00,};
const unsigned char PROGMEM iconoJuegos[] = {0x00, 0x00,  0xDF, 0xFC,  0x90, 0x04,  0xD3, 0xE4,  0xD3, 0xE4,  0x93, 0xE4,  0xD3, 0xE4,  0xD0, 0x04,  0xDF, 0xFC,  0xDB, 0xD4,  0xD1, 0xFC,  0xDB, 0xFC,  0xDF, 0xF8,  0xDF, 0xF0,  0x00, 0x00,  0x00, 0x00,};
const unsigned char PROGMEM iconoDormir[] = {0x00, 0x00,  0x00, 0x00,  0x80, 0x00,  0x80, 0x00,  0x80, 0x00,  0xEF, 0xFE,  0x9F, 0x17,  0x8F, 0xFF,  0x8F, 0xFF,  0xF8, 0x01,  0xFF, 0xFD,  0xE0, 0x07,  0x00, 0x00,  0x00, 0x00,  0x00, 0x00,0x00, 0x00,};
const unsigned char PROGMEM iconoMoneda[] = {0x1C, 0x00,  0x22, 0x00,  0x49, 0x00,  0x45, 0x00,  0x55, 0x00,  0x55, 0x00,  0x45, 0x00,  0x49, 0x00,  0x22, 0x00,  0x1C, 0x00,};
//==== Iconos games ====
// 40x40 ejemplo simple
const unsigned char PROGMEM iconoPonk[] = { 0x80, 0x00, 0x00, 0x00, 0x01,  0x00, 0x00, 0x00, 0x00, 0x00,  0x00, 0x00, 0x00,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 0xD8,
  0x1E, 0xFF, 0xFF, 0xFB, 0x58,  0x1E, 0xFF, 0xFF, 0xFB, 0x58,  0x1E, 0xFF,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 0x88,
  0x11, 0xFF, 0xC3, 0xFF, 0x88,  0x11, 0xFF, 0xE7, 0xFF, 0x88,  0x11, 0xFF,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 0x01,};
const unsigned char PROGMEM iconoBlock[] = {  0x7F, 0xFF, 0xFF, 0xFF, 0xFE,  0xFF, 0xFF, 0xFF, 0xFF, 0xFF,  0xFF, 0xFF, 0xFF,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 0xF7,
  0xE1, 0xFC, 0x10, 0x3F, 0x87,  0xE1, 0xFC, 0x10, 0x3F, 0x87,  0xEF, 0xFF,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 0x07,
  0xE0, 0x00, 0x30, 0x00, 0x07,  0xE0, 0x00, 0x80, 0x00, 0x07,  0xE0, 0x01,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 0xFE,};
const unsigned char PROGMEM iconoFlappy[] = {0x7F, 0xFF, 0xFF, 0xFF, 0xFE,  0xFF, 0xFF, 0xFF, 0xFF, 0xFF,  0xFF, 0xFC, 0x1F,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 0xC7,  
  0xE0, 0x03, 0xE0, 0x07, 0xC7,  0xE0, 0x03, 0xE0, 0x07, 0xC7,  0xE0, 0x03,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 0x07,
  0xE2, 0x00, 0x00, 0x00, 0x07,  0xE0, 0x00, 0x00, 0x00, 0x07,  0xE0, 0x00,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 0xFE,};
const unsigned char PROGMEM iconoSalir[] = {  0x7F, 0xFF, 0xFF, 0xFF, 0xFE,  0xFF, 0xFF, 0xFF, 0xFF, 0xFF,  0xFF, 0xFF, 0xFF,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 0x07,
  0xE0, 0x0E, 0xAE, 0x40, 0x07,  0xE0, 0x00, 0x00, 0x00, 0x07,  0xE0, 0x00,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 0x87,
  0xE0, 0x0F, 0x01, 0xFF, 0x87,  0xE0, 0x1F, 0x81, 0xFF, 0x87,  0xE0, 0x3F,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 0xFE,};
const unsigned char PROGMEM iconoDormir2[] = {0x00, 0x00, 0x00, 0x00, 0x00,  0x00, 0x00, 0x00, 0x00, 0x00,  0x00, 0x00, 0x00,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 0x00, 
    0x00, 0x03, 0x00, 0xC0, 0x00,  0x00, 0x04, 0x00, 0x20, 0x00,  0x00, 0x08,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 0x00,
    0x00, 0x04, 0x42, 0x20, 0x00,  0x00, 0x04, 0x42, 0x20, 0x00,  0x00, 0x02,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 0x00,};



const unsigned char PROGMEM iconoCreditos[] = {0x00, 0x00, 0x00, 0x00, 0x00,  0x00, 0x00, 0x00, 0x00, 0x00,  0x00, 0x00, 0x00,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 0x00,
    0x00, 0x08, 0x00, 0x10, 0x00,  0x00, 0x08, 0x00, 0x10, 0x00,  0x00, 0x0B,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 0x70,
    0x0F, 0xF8, 0x00, 0x1F, 0xF0,  0x0F, 0xF7, 0x81, 0xEF, 0xF0,  0x0F, 0xF8,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 0x00,

}; // Ejemplo simple

const unsigned char PROGMEM iconoReset[] = {0x00, 0x00, 0x00, 0x00, 0x00,  0x00, 0x00, 0x00, 0x00, 0x00,  0x00, 0x00, 0x00,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 0x00,
    0x00, 0x07, 0xFF, 0xFF, 0x00,  0x00, 0x0F, 0xFF, 0xFF, 0x80,  0x00, 0x1F,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 0xF0,
    0x00, 0x06, 0x00, 0x7F, 0xE0,  0x00, 0x00, 0x00, 0xFF, 0xE0,  0x00, 0x00,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 0x00,
}; // Ejemplo simple



#include <EEPROM.h>
#include <Adafruit_GFX.h>
#include <Adafruit_SSD1306.h>

// =================== DISPLAY ===================
#define SCREEN_WIDTH 128
#define SCREEN_HEIGHT 64
Adafruit_SSD1306 display(SCREEN_WIDTH, SCREEN_HEIGHT, &Wire, -1);

// =================== PINES ===================
#define BTN0 2
#define BTN1 3
#define BTN2 4
#define BUZZER 9

// =================== VARIABLES GENERALES ===================
int hambre = 100;
int energia = 100;
int monedas = 0;

int salaActual = 0;
const int totalSalas = 3;
const char* nombresSalas[3] = {"Cocina", "Juegos", "Habitacion"};
const unsigned char* iconosSalas[3] = {iconoFood, iconoJuegos, iconoDormir};
int porcentajeSalas[3] = {100, 60, 90};

// =================== PROGRESO (HUEVO) ===================
int progreso = 0;
const int maxProgreso = 5;
const char* frases[5] = {
  "hey esta por iniciar un nuevo mundo",
  "ya esta mas cerca",
  "como se llamara",
  "un poco mas",
  "3..2..1..Vamos!!"
};

const unsigned char* framesHuevo[4] = {huevo1, huevo2, huevo3, huevo4};
const unsigned char* framesBB[4] = {bb1, bb2, bb3, bb4};
unsigned long ultimoCambio = 0;
int frameActual = 0;

// =================== MENÚS ===================
bool menuCocinaActivo = false;
bool menuHabitacionActivo = false;
bool menuJuegosActivo = false;

bool parpadeoActivo = false;
unsigned long inicioParpadeo = 0;

// =================== MENÚ COCINA ===================
int opcionCocina = 0;
const int totalOpcionesCocina = 8;

const char* nombresComida[7] = {
  "Pan", "Galleta", "Carne", "Sopa", "Hamburguesa", "Vitamina", "Energetizante"
};
const int valorEfecto[7] = {10, 15, 25, 30, 40, 100, 100};
const int costoComida[7] = {5, 8, 12, 15, 20, 35, 40};
const bool afectaEnergia[7] = {false, false, false, false, false, false, true};

const unsigned char* iconosComida[7] = {
  iconoPan, iconoGalleta, iconoCarne, iconoSopa, iconoHamburguesa,
  iconoVitamina, iconoEnergetizante
};

// =================== MENÚ HABITACIÓN ===================
int opcionHabitacion = 0;
const int totalOpcionesHabitacion = 4;
const char* nombresHabitacion[4] = {"Dormir", "Creditos", "Reset", "Salir"};
const unsigned char* iconosHabitacion[4] = {
  iconoDormir2, iconoCreditos, iconoReset, iconoSalir
};

// =================== MENÚ JUEGOS ===================
// =================== VARIABLES PARA LOS JUEGOS ===================

// PONK
int paddleX = 48;
const int paddleWidth = 20;
const int paddleHeight = 4;
int paddleCPU_X = 48;
unsigned long ultimoMovimientoCPU = 0;
int delayCPU = 80;
int ballX = 64, ballY = 30;
int ballVelX = 1, ballVelY = 1;
bool esperandoPelota = false;
unsigned long tiempoEsperaPelota = 0;

// BLOCK BREAKER
static int paddleX_BB = 48;
static int ballX_BB = 64, ballY_BB = 32;
static int ballVelX_BB = 1, ballVelY_BB = -1;
static bool bloques[4][8];
static bool nivelIniciado = false;
static int vidasBB = 3;

// FLAPPY DAPY
static int birdX = 30, birdY = 30;
static int birdVel = 0;
static int obstX = 128, gapY = 20;
static int vidasFD = 3;
static int obstaculosPasados = 0;
const int gapAltura = 35;
static bool iniciadoFD = false;


int opcionJuego = 0;
const int totalJuegos = 4;
const char* nombresJuegos[4] = {"Ponk", "Block Breaker", "Flappy Dapy", "Regresar"};
const unsigned char* iconosJuegos[4] = {iconoPonk, iconoBlock, iconoFlappy, iconoSalir};
bool enJuego = false;
int juegoActual = -1;

// =================== HABITACIÓN: BLOQUEO Y CANCIÓN ===================
bool durmiendo = false;
unsigned long tiempoDormir = 0;
const int notas[] = {392, 440, 392, 330, 392, 440, 392, 330}; 
const int duraciones[] = {300, 300, 300, 600, 300, 300, 300, 600};

// =================== EEPROM ===================
void guardarMonedas() { EEPROM.put(0, monedas); }
void cargarMonedas() {
  EEPROM.get(0, monedas);
  if (monedas < 0 || monedas > 9999) monedas = 0;
}

// =================== SONIDO ===================
void sonidoHuevo() {
  tone(BUZZER, 1000, 200);
  delay(250);
  tone(BUZZER, 1500, 200);
  noTone(BUZZER);
}

void sonidoMover() {
  tone(BUZZER, 1200, 50);
  delay(80);
  noTone(BUZZER);
}

void sonidoComer() {
  tone(BUZZER, 800, 150);
  delay(200);
  noTone(BUZZER);
}

void cancionDormir() {
  for (int i = 0; i < 8; i++) {
    tone(BUZZER, notas[i], duraciones[i]);
    delay(duraciones[i] * 1.3);
  }
  noTone(BUZZER);
}

// =================== RESET ===================
void resetGame() {
  monedas = 0;
  hambre = 100;
  energia = 100;
  progreso = 0;
  guardarMonedas();
}

// =================== SETUP ===================
void setup() {
  display.begin(SSD1306_SWITCHCAPVCC, 0x3C);
  display.clearDisplay();
  display.display();

  pinMode(BTN0, INPUT_PULLUP);
  pinMode(BTN1, INPUT_PULLUP);
  pinMode(BTN2, INPUT_PULLUP);
  pinMode(BUZZER, OUTPUT);

  cargarMonedas();
}

// =================== DIBUJAR PERSONAJE ===================
void dibujarPersonajeEsquina() {
  if (progreso >= maxProgreso) {
    display.drawBitmap(2, 2, framesBB[frameActual], 16, 16, WHITE); // esquina superior izquierda
  }
}





// =================== LOOP ===================
void loop() {
  bool btn0 = digitalRead(BTN0) == LOW;
  bool btn1 = digitalRead(BTN1) == LOW;
  bool btn2 = digitalRead(BTN2) == LOW;

  // =================== BLOQUEO DURMIENDO ===================
  if (durmiendo) {
    display.clearDisplay();
    display.invertDisplay(true);
    display.setCursor(20, 20);
    display.setTextSize(1);
    display.print("Durmiendo...");
    display.display();

    if (millis() - tiempoDormir > 1000) {
      porcentajeSalas[2] += 5;
      if (porcentajeSalas[2] >= 100) {
        porcentajeSalas[2] = 100;
        durmiendo = false;
        display.invertDisplay(false);
      } else {
        tiempoDormir = millis();
      }
    }
    return;
  }

  display.clearDisplay();

  // =================== MENÚ COCINA ===================
  if (menuCocinaActivo) {
    if (parpadeoActivo) {
      if (millis() - inicioParpadeo >= 3000) {
        parpadeoActivo = false;
        if (opcionCocina == 7) {
          menuCocinaActivo = false;
        } else if (monedas >= costoComida[opcionCocina]) {
          monedas -= costoComida[opcionCocina];
          hambre = max(0, hambre - valorEfecto[opcionCocina]);
          if (afectaEnergia[opcionCocina])
            energia = min(100, energia + valorEfecto[opcionCocina]);
          guardarMonedas();
          sonidoComer();
        }
      } else if ((millis() / 300) % 2 == 0) {
        display.drawBitmap((128 - 40) / 2, 6,
                           (opcionCocina == 7 ? iconosJuegos[3] : iconosComida[opcionCocina]),
                           40, 40, WHITE);
      }
    } else {
      if (btn0) { opcionCocina = (opcionCocina - 1 + totalOpcionesCocina) % totalOpcionesCocina; delay(200); }
      if (btn2) { opcionCocina = (opcionCocina + 1) % totalOpcionesCocina; delay(200); }
      if (btn1) { inicioParpadeo = millis(); parpadeoActivo = true; }

      display.setTextColor(WHITE); 
      display.drawBitmap((128 - 40) / 2, 6,
                         (opcionCocina == 7 ? iconosJuegos[3] : iconosComida[opcionCocina]),
                         40, 40, WHITE);

      display.setCursor(40, 50);
      display.print(opcionCocina == 7 ? "Regresar" : nombresComida[opcionCocina]);

      // Mostrar porcentaje abajo
      if (opcionCocina != 7) {
        display.setCursor(40, 58);
        display.print("+");
        display.print(valorEfecto[opcionCocina]);
        display.print("%");
      }

      // Mostrar precio en esquina vacía
      if (opcionCocina != 7) {
        display.setCursor(2, 58);
        display.print("$");
        display.print(costoComida[opcionCocina]);
      }

      display.drawBitmap(112, 2, iconoMoneda, 10, 10, WHITE);
      display.setCursor(98, 4);
      display.print(monedas);

      dibujarPersonajeEsquina();
    }
    display.display();
    return;
  }

  // =================== MENÚ HABITACIÓN ===================
  if (menuHabitacionActivo) {
    if (parpadeoActivo) {
      if (millis() - inicioParpadeo >= 3000) {
        parpadeoActivo = false;
        if (opcionHabitacion == 3) {
          menuHabitacionActivo = false;
        } else if (opcionHabitacion == 0) {
          durmiendo = true;
          tiempoDormir = millis();
          cancionDormir();
        } else if (opcionHabitacion == 1) {
          // Créditos
          display.clearDisplay();
          display.setCursor(10, 20);
          display.print("By: Team Dinosaurios");
          display.display();
          delay(1500);
        } else if (opcionHabitacion == 2) {
          resetGame();
        }
      } else if ((millis() / 300) % 2 == 0) {
        display.drawBitmap((128 - 40) / 2, 8, iconosHabitacion[opcionHabitacion], 40, 40, WHITE);
      }
    } else {
      if (btn0) { opcionHabitacion = (opcionHabitacion - 1 + totalOpcionesHabitacion) % totalOpcionesHabitacion; delay(200); }
      if (btn2) { opcionHabitacion = (opcionHabitacion + 1) % totalOpcionesHabitacion; delay(200); }
      if (btn1) { inicioParpadeo = millis(); parpadeoActivo = true; }

      display.setTextColor(WHITE); 
      display.drawBitmap((128 - 40) / 2, 8, iconosHabitacion[opcionHabitacion], 40, 40, WHITE);
      display.setCursor((128 - strlen(nombresHabitacion[opcionHabitacion]) * 6) / 2, 54);
      display.print(nombresHabitacion[opcionHabitacion]);

      display.drawBitmap(112, 2, iconoMoneda, 10, 10, WHITE);
      display.setCursor(98, 4);
      display.print(monedas);

      dibujarPersonajeEsquina();
    }
    display.display();
    return;
  }

  // =================== MENÚ JUEGOS ===================
  if (menuJuegosActivo) {
    if (parpadeoActivo) {
      if (millis() - inicioParpadeo >= 3000) {
        parpadeoActivo = false;
        if (opcionJuego == 3) { menuJuegosActivo = false; enJuego = false; }
        else { enJuego = true; menuJuegosActivo = false; juegoActual = opcionJuego; }
      } else if ((millis() / 300) % 2 == 0) {
        display.drawBitmap((128 - 40) / 2, 8, iconosJuegos[opcionJuego], 40, 40, WHITE);
      }
    } else {
      if (btn0) { opcionJuego = (opcionJuego - 1 + totalJuegos) % totalJuegos; delay(200); }
      if (btn2) { opcionJuego = (opcionJuego + 1) % totalJuegos; delay(200); }
      if (btn1) { inicioParpadeo = millis(); parpadeoActivo = true; }

      display.setTextColor(WHITE); 
      display.drawBitmap((128 - 40) / 2, 8, iconosJuegos[opcionJuego], 40, 40, WHITE);
      display.setCursor((128 - strlen(nombresJuegos[opcionJuego]) * 6) / 2, 54);
      display.print(nombresJuegos[opcionJuego]);

      display.drawBitmap(112, 2, iconoMoneda, 10, 10, WHITE);
      display.setCursor(98, 4);
      display.print(monedas);

      dibujarPersonajeEsquina();
    }
    display.display();
    return;
  }

  // =================== INTERFAZ PRINCIPAL ===================
  display.fillRect(0, 0, 128, 10, WHITE);
  display.setTextSize(1);
  display.setTextColor(BLACK, WHITE);
  display.setCursor(2, 2);
  display.print(porcentajeSalas[salaActual]);
  display.print("%");

  display.drawBitmap(112, 0, iconoMoneda, 10, 10, BLACK);
  display.setCursor(98, 2);
  display.print(monedas);

  if (progreso < maxProgreso) {
    display.fillRect(0, 50, 128, 14, WHITE);
    display.setTextColor(BLACK, WHITE);
    display.setCursor(2, 54);
    display.print(frases[progreso]);

    if (millis() - ultimoCambio > 300) {
      frameActual = (frameActual + 1) % 4;
      ultimoCambio = millis();
    }
    display.drawBitmap((128 - 32) / 2, 16, framesHuevo[frameActual], 32, 32, WHITE);

    if (btn1) { sonidoHuevo(); progreso++; delay(300); }
  } else {
    display.fillRect(0, 50, 128, 14, WHITE);
    display.setTextColor(BLACK, WHITE);
    display.setCursor(22, 54);
    display.print(nombresSalas[salaActual]);
    display.drawBitmap(2, 48, iconosSalas[salaActual], 16, 16, BLACK);

    if (millis() - ultimoCambio > 300) {
      frameActual = (frameActual + 1) % 4;
      ultimoCambio = millis();
    }
    display.drawBitmap((128 - 32) / 2, 16, framesBB[frameActual], 32, 32, WHITE);

    if (btn0) { salaActual = (salaActual - 1 + totalSalas) % totalSalas; sonidoMover(); delay(200); }
    if (btn2) { salaActual = (salaActual + 1) % totalSalas; sonidoMover(); delay(200); }
    if (btn1) {
      if (salaActual == 0) { menuCocinaActivo = true; opcionCocina = 0; }
      else if (salaActual == 1) { menuJuegosActivo = true; opcionJuego = 0; }
      else if (salaActual == 2) { menuHabitacionActivo = true; opcionHabitacion = 0; }
      delay(300);
    }
  }
  display.display();
}
